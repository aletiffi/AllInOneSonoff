#include <ESP8266WiFi.h>
#include <WiFiClientSecure.h>
#include <ESP8266HTTPClient.h>
#include <ESP8266httpUpdate.h>
#include <StackThunk.h>
#include <OtaLogic.h>
#include <memory>
#include "OtaSigningKey.h"        // Generated by scripts/signing.py
#include "Ota.h"
#include "Config.h"
#include "Settings.h"
#include "Device.h"
#include "Network.h"
#include "Mqtt.h"

#define MAX_LENGTH_VERSION        24
#define MAX_LENGTH_BIN_URL        256

#if OTA_SIGNING
// Only firmwares signed with keys/private.key are accepted
static BearSSL::PublicKey signPubKey(OTA_SIGNING_PUBKEY);
static BearSSL::HashSHA256 signHash;
static BearSSL::SigningVerifier signVerifier(&signPubKey);
#else
#warning "keys/public.key not found: OTA updates are not verified"
#endif

static bool otaRequested           = false;
static bool firstCheckDone         = false;
static unsigned long lastOtaCheck  = 0;
static String otaStatus            = "Never checked";
static String latestVersion        = "";

static std::unique_ptr<WiFiClient> MakeClient(const char* url) {
  if (ota_is_https(url)) {
    std::unique_ptr<BearSSL::WiFiClientSecure> secure(new BearSSL::WiFiClientSecure());
    // Connection encrypted but server not verified (no root CAs nor reliable clock on the device):
    // the authenticity of the firmware is guaranteed by its signature
    secure->setInsecure();
    return std::unique_ptr<WiFiClient>(secure.release());
  }
  return std::unique_ptr<WiFiClient>(new WiFiClient());
}

static void SetStatus(const String& status) {
  otaStatus = status;
  Serial.println("OTA: " + status);
  // Home Assistant "update" entity
  Mqtt_PublishUpdateState(false);
}

static bool DownloadManifest(const char* url, char* version, char* binUrl) {
  std::unique_ptr<WiFiClient> client = MakeClient(url);
  HTTPClient http;
  http.setFollowRedirects(HTTPC_FORCE_FOLLOW_REDIRECTS);
  http.setTimeout(T_10S);

  if (!http.begin(*client, url)) {
    SetStatus("Invalid manifest url");
    return false;
  }
  int code = http.GET();
  if (code != HTTP_CODE_OK) {
    SetStatus("Manifest download error: " + (code < 0 ? http.errorToString(code) : "HTTP " + String(code)));
    http.end();
    return false;
  }
  String body = http.getString();
  http.end();

  switch (ota_parse_manifest(body.c_str(), version, MAX_LENGTH_VERSION, binUrl, MAX_LENGTH_BIN_URL)) {
    case OTA_MANIFEST_OK:
      return true;
    case OTA_MANIFEST_INVALID_JSON:
      SetStatus("Manifest is not a valid json (is the file shared?)");
      return false;
    case OTA_MANIFEST_MISSING_FIELDS:
      SetStatus("Manifest without version or url");
      return false;
    default:
      SetStatus("Manifest fields too long");
      return false;
  }
}

static void InstallFirmware(const char* binUrl) {
  // Frees memory for the TLS connection
  Mqtt_Disconnect();
  Led.Off();

#if OTA_SIGNING
  Update.installSignature(&signHash, &signVerifier);
  // The RSA verification needs the second stack also with http urls
  stack_thunk_add_ref();
#endif

  std::unique_ptr<WiFiClient> client = MakeClient(binUrl);
  ESPhttpUpdate.setFollowRedirects(HTTPC_FORCE_FOLLOW_REDIRECTS);
  ESPhttpUpdate.setLedPin(SONOFF_LED, LOW);
  ESPhttpUpdate.rebootOnUpdate(true);
  t_httpUpdate_return ret = ESPhttpUpdate.update(*client, binUrl, FW_VERSION);

#if OTA_SIGNING
  stack_thunk_del_ref();
#endif

  switch (ret) {
    case HTTP_UPDATE_FAILED:
      if (Update.getError() == UPDATE_ERROR_SIGN) {
        SetStatus("Update refused: firmware not signed or signed with another key");
      } else {
        SetStatus("Update failed (" + String(ESPhttpUpdate.getLastError()) + "): " + ESPhttpUpdate.getLastErrorString());
      }
      break;
    case HTTP_UPDATE_NO_UPDATES:
      SetStatus("No new update available");
      break;
    case HTTP_UPDATE_OK:
      // Normally not reached: the device restarts
      SetStatus("Update OK");
      break;
  }
  if (deviceConnected) {
    Led.On();
  }
}

void Ota_Check() {
  otaRequested = false;
  firstCheckDone = true;
  lastOtaCheck = millis();

  if (!ota_is_valid_url(OtaUrl.Val.c_str())) {
    SetStatus("Update url not set");
    return;
  }
  if (!deviceConnected) {
    SetStatus("Device not connected");
    return;
  }

  char manifestUrl[MAX_LENGTH_BIN_URL];
  char version[MAX_LENGTH_VERSION];
  char binUrl[MAX_LENGTH_BIN_URL];
  if (!ota_normalize_url(OtaUrl.Val.c_str(), manifestUrl, sizeof(manifestUrl))) {
    SetStatus("Update url too long");
    return;
  }
  Serial.println("OTA: manifest " + String(manifestUrl) + " (free heap " + String(ESP.getFreeHeap()) + ")");
  if (!DownloadManifest(manifestUrl, version, binUrl)) {
    return;
  }
  latestVersion = version;

  if (!ota_is_update_needed(version, FW_VERSION)) {
    SetStatus("Firmware up to date (" FW_VERSION ", available " + String(version) + ")");
    return;
  }

  otaStatus = "Updating " FW_VERSION " -> " + String(version);
  Serial.println("OTA: " + otaStatus);
  Mqtt_PublishUpdateState(true);
  InstallFirmware(binUrl);
}

void Ota_Request() {
  otaRequested = true;
  otaStatus = "Checking...";
}

String Ota_Status() {
  return otaStatus;
}

String Ota_LatestVersion() {
  return latestVersion;
}

bool Ota_IsSigningEnabled() {
  return OTA_SIGNING;
}

void Ota_Loop() {
  if (!deviceConnected) {
    return;
  }
  // On request, at the first connection and then every hour
  if (otaRequested || (!firstCheckDone && ota_is_valid_url(OtaUrl.Val.c_str())) || millis() - lastOtaCheck > T_1H) {
    Ota_Check();
  }
}
